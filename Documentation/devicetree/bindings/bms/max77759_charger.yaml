## Documentation/devicetree/bindings/bms/max77759_charger.yaml
```yaml
# SPDX-License-Identifier: GPL-2.0
# Copyright 2024 Google LLC
%YAML 1.2
---

$schema: http://devicetree.org/meta-schemas/core.yaml#

title: max77759 charger driver

maintainers:
  - Daniel Okazaki <dtokazaki@google.com>
  - Prasanna Prapancham <prapancham@google.com>
  - Jack Wu <wjack@google.com>
  - Ken Yang <yangken@google.com>
  - Baltazar Ortiz <baltazarortiz@google.com>

description: |
  max77759 charger driver

properties:
  # A dictionary of DT properties for this binding schema
  compatible:
    enum:
      - maxim,max77759chrg

  reg:
    description: i2c address of the charger.

  max77759,psy-name:
    description: max77759 charger power supply name
    $ref: /schemas/types.yaml#/definitions/string

  google,max77759-thm2-monitor:
    description: Enable thm2 monitoring
    type: boolean

  max77759,usb-mon:
    description: When not set, disables thm2 monitoring.
    When set, leaves thm2 register as is.
    type: boolean

  max77759,otg-fccm-vbatt-upperbd:
    description: Upper batt voltage threshold to enable external boost for OTG.
    $ref: /schemas/types.yaml#/definitions/uint32

  max77759,otg-fccm-vbatt-lowerbd:
    description: Lower batt voltage threshold to disable external boost for OTG.
    $ref: /schemas/types.yaml#/definitions/uint32

  max77759,chg-term-voltage:
    description: Charge termination voltage.
    $ref: /schemas/types.yaml#/definitions/uint32

  max77759,chg-term-volt-debounce:
    description: Charge termination voltage debounce voltage.
    $ref: /schemas/types.yaml#/definitions/uint32

  max77759,usb-otg-mv:
    description: OTG bypass output voltage
    $ref: /schemas/types.yaml#/definitions/uint32

  max77759,dcin-is-dock:
    description: DC input is a dock.
    type: boolean

  max77759,wcin-inlim-period:
    description: Number of milliseconds between ilim tracking polling.
    $ref: /schemas/types.yaml#/definitions/uint32

  max77759,wcin-inlim-headroom:
    description: Headroom above actual current allowed.
    $ref: /schemas/types.yaml#/definitions/uint32

  max77759,wcin_inlim_step:
    description: Maximum step size per timestep.
    $ref: /schemas/types.yaml#/definitions/uint32

  max77759_gpio:
    description: GPIO controller config.

  max77759,irq-gpio:
    description: IRQ gpio

  max77759,pmic:
    description: max77759 PMIC device phandle.
    $ref: /schemas/types.yaml#/definitions/phandle

  max77759,max_m5:
    description: max77759 Fuel Gauge device phandle.
    $ref: /schemas/types.yaml#/definitions/phandle

  max77759,dc-psy-type-wireless:
    description: DC input is a wireless power supply.
    type: boolean

  max77759,dc-psy-name:
    description: Name of DC power supply
    $ref: /schemas/types.yaml#/definitions/string

required:
  - compatible
  - reg
  - #thermal-sensor-cells

dependencies:
  max77759,otg-fccm-vbatt-lowerbd: [ 'max77759,otg-fccm-vbatt-upperbd' ]
  max77759,chg-term-volt-debounce: [ 'max77759,chg-term-voltage' ]
```
